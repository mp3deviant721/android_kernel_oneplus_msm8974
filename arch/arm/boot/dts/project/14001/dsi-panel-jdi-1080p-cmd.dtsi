/************************************************************
* Copyright (c) 2013-2013 OPPO Mobile communication Corp.ltd.,
* VENDOR_EDIT
* Description: device tree for jdi cmd panel.
* Version    : 1.0
* Date       : 2013-12-12
* Author     : yangxinqin
 *
 * This program is free software; you can redistribute it and/or modify
 * it under the terms of the GNU General Public License version 2 and
 * only version 2 as published by the Free Software Foundation.
 *
 * This program is distributed in the hope that it will be useful,
 * but WITHOUT ANY WARRANTY; without even the implied warranty of
 * MERCHANTABILITY or FITNESS FOR A PARTICULAR PURPOSE.  See the
 * GNU General Public License for more details.
 */

&mdss_mdp {
	dsi_jdi_1080_cmd: qcom,mdss_dsi_jdi_1080p_cmd {
		compatible = "qcom,mdss-dsi-panel";
		status = "ok";
		qcom,mdss-dsi-panel-name = "JDI R63417 1080p cmd mode dsi panel";
		qcom,mdss-dsi-panel-controller = <&mdss_dsi0>;
		qcom,mdss-dsi-panel-type = "dsi_cmd_mode";
		qcom,mdss-dsi-panel-destination = "display_1";
		qcom,mdss-dsi-panel-clockrate = <854960000>;
		qcom,mdss-dsi-panel-width = <1080>;
		qcom,mdss-dsi-panel-height = <1920>;
		qcom,mdss-dsi-h-front-porch = <4>;
		qcom,mdss-dsi-h-back-porch = <2>;
		qcom,mdss-dsi-h-left-border = <0>;
		qcom,mdss-dsi-h-right-border = <0>;
		qcom,mdss-dsi-h-pulse-width = <2>;
		qcom,mdss-dsi-h-sync-pulse = <1>;
		qcom,mdss-dsi-v-back-porch = <2>;
		qcom,mdss-dsi-v-front-porch = <2>;
		qcom,mdss-dsi-v-pulse-width = <2>;
		qcom,mdss-dsi-bpp = <24>;
		qcom,mdss-dsi-underflow-color = <0x00>;
		qcom,mdss-dsi-panel-timings = [CE 36 38 00 5B 53 37 37 2A 03 04 00];
		qcom,mdss-dsi-on-command = [
			15 01 00 00 00 00 02 00 83
			15 01 00 00 00 00 02 F3 CA
			15 01 00 00 00 00 02 00 90
			15 01 00 00 00 00 02 C4 00
			15 01 00 00 00 00 02 00 B0
			39 01 00 00 00 00 0F
			C5 92 D6 A0 15 A0 1E A0 06
			A0 0C 44 33 30 88
			15 01 00 00 00 00 02 00 00
			15 01 00 00 00 00 02 35 00
			39 01 00 00 00 00 05
			2A 00 00 04 37
			39 01 00 00 00 00 05
			2B 00 00 07 7F
			05 01 00 00 78 00 01 11
			05 01 00 00 00 00 01 29];
		qcom,mdss-dsi-off-command = [
			05 01 00 00 32 00 01 28
			05 01 00 00 64 00 01 10];
		qcom,mdss-dsi-off-command-state = "dsi_hs_mode";
		qcom,mdss-dsi-bllp-eof-power-mode;
		qcom,mdss-dsi-bllp-power-mode;
		qcom,mdss-dsi-lane-0-state;
		qcom,mdss-dsi-lane-1-state;
		qcom,mdss-dsi-lane-2-state;
		qcom,mdss-dsi-lane-3-state;
		qcom,mdss-dsi-te-check-enable;
		qcom,mdss-dsi-te-using-te-pin;
		qcom,mdss-dsi-t-clk-post = <0x4>;
		qcom,mdss-dsi-t-clk-pre = <0x2A>;
		qcom,mdss-dsi-bl-min-level = <1>;
		qcom,mdss-dsi-bl-pmic-control-type = "bl_ctrl_wled";
		qcom,cont-splash-enabled;
		qcom,ulps-enabled;
	};
};
